## components/gem5/patches/src/arch/Kconfig.patch
```kconfig
diff --git a/src/arch/Kconfig b/src/arch/Kconfig
index 729265c..d038604 100644
--- a/src/arch/Kconfig
+++ b/src/arch/Kconfig
@@ -37,6 +37,7 @@ menu "ISA"
 if BUILD_ISA
 
 rsource "arm/Kconfig"
+rsource "dadao/Kconfig"
 rsource "mips/Kconfig"
 rsource "power/Kconfig"
 rsource "riscv/Kconfig"
```

## components/qemu/patches/hw/Kconfig.patch
```kconfig
diff --git a/hw/Kconfig b/hw/Kconfig
index c92ca2b13a..d6bc153314 100644
--- a/hw/Kconfig
+++ b/hw/Kconfig
@@ -53,6 +53,7 @@ source arm/Kconfig
 source cpu/Kconfig
 source alpha/Kconfig
 source avr/Kconfig
+source dadao/Kconfig
 source hexagon/Kconfig
 source hppa/Kconfig
 source i386/Kconfig
```

## components/qemu/patches/target/Kconfig.patch
```kconfig
diff --git a/target/Kconfig b/target/Kconfig
index 0288a3f..cebaaa4 100644
--- a/target/Kconfig
+++ b/target/Kconfig
@@ -1,6 +1,7 @@
 source alpha/Kconfig
 source arm/Kconfig
 source avr/Kconfig
+source dadao/Kconfig
 source hppa/Kconfig
 source i386/Kconfig
 source loongarch/Kconfig
```
